## conf/layer.conf
```bitbake
# We have a conf and classes directory, add to BBPATH
BBPATH .= ":${LAYERDIR}"

# We have recipes-* directories, add to BBFILES
BBFILES += "${LAYERDIR}/recipes-*/*/*.bb \
            ${LAYERDIR}/recipes-*/*/*.bbappend"

BBFILE_COLLECTIONS += "meta-mwatch-mod"
BBFILE_PATTERN_meta-mwatch-mod = "^${LAYERDIR}/"
BBFILE_PRIORITY_meta-mwatch-mod = "1"

LAYERDEPENDS_meta-mwatch-mod = "core"
LAYERSERIES_COMPAT_meta-mwatch-mod = "mickledore"
```
